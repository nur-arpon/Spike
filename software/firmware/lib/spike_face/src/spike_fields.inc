// GENERATED by software/firmware/tools/gen_tables.js from software/face_v2 -- do not edit.

// X(name, default, lo, hi, spring_k, spring_d)
#define SPIKE_FIELDS(X) \
  X(lookX, 0.0f, -1.2f, 1.2f, 520.0f, 36.0f) \
  X(lookY, 0.0f, -1.2f, 1.2f, 520.0f, 36.0f) \
  X(cross, 0.0f, 0.0f, 1.0f, 320.0f, 24.0f) \
  X(eyeScale, 1.0f, 0.4f, 1.6f, 260.0f, 14.0f) \
  X(eyeScaleL, 1.0f, 0.4f, 1.6f, 260.0f, 14.0f) \
  X(eyeScaleR, 1.0f, 0.4f, 1.6f, 260.0f, 14.0f) \
  X(eyeSX, 1.0f, 0.5f, 1.6f, 260.0f, 14.0f) \
  X(eyeSY, 1.0f, 0.4f, 1.6f, 260.0f, 14.0f) \
  X(eyeDY, 0.0f, -14.0f, 14.0f, 210.0f, 17.0f) \
  X(eyeSpread, 0.0f, -14.0f, 14.0f, 210.0f, 17.0f) \
  X(lidTL, 0.0f, 0.0f, 1.0f, 900.0f, 36.0f) \
  X(lidTR, 0.0f, 0.0f, 1.0f, 900.0f, 36.0f) \
  X(lidBL, 0.0f, 0.0f, 1.0f, 900.0f, 36.0f) \
  X(lidBR, 0.0f, 0.0f, 1.0f, 900.0f, 36.0f) \
  X(lidTilt, 0.0f, -1.2f, 1.2f, 210.0f, 17.0f) \
  X(lidSag, 0.0f, 0.0f, 1.0f, 210.0f, 17.0f) \
  X(lidBulge, 0.0f, 0.0f, 1.0f, 210.0f, 17.0f) \
  X(blinkL, 0.0f, -0.6f, 1.0f, 900.0f, 36.0f) \
  X(blinkR, 0.0f, -0.6f, 1.0f, 900.0f, 36.0f) \
  X(shut, 0.0f, 0.0f, 1.0f, 320.0f, 24.0f) \
  X(happy, 0.0f, 0.0f, 1.0f, 320.0f, 24.0f) \
  X(wink, 0.0f, -1.0f, 1.0f, 320.0f, 24.0f) \
  X(pupil, 1.0f, 0.2f, 1.8f, 210.0f, 17.0f) \
  X(shine, 1.0f, 0.0f, 2.0f, 210.0f, 17.0f) \
  X(sparkle, 0.0f, 0.0f, 1.0f, 60.0f, 14.0f) \
  X(tear, 0.0f, 0.0f, 1.0f, 60.0f, 14.0f) \
  X(cry, 0.0f, 0.0f, 1.0f, 60.0f, 14.0f) \
  X(iconAmt, 0.0f, 0.0f, 1.3f, 260.0f, 14.0f) \
  X(browY, 0.0f, -1.5f, 1.5f, 210.0f, 17.0f) \
  X(browTilt, 0.0f, -1.2f, 1.2f, 210.0f, 17.0f) \
  X(noseDX, 0.0f, -10.0f, 10.0f, 700.0f, 22.0f) \
  X(noseDY, 0.0f, -10.0f, 10.0f, 700.0f, 22.0f) \
  X(noseSX, 1.0f, 0.6f, 1.5f, 700.0f, 22.0f) \
  X(noseSY, 1.0f, 0.6f, 1.5f, 700.0f, 22.0f) \
  X(scrunch, 0.0f, 0.0f, 1.0f, 210.0f, 17.0f) \
  X(smile, 0.3f, -1.2f, 1.2f, 210.0f, 17.0f) \
  X(open, 0.0f, 0.0f, 1.0f, 210.0f, 17.0f) \
  X(mouthW, 1.0f, 0.4f, 1.5f, 210.0f, 17.0f) \
  X(mouthO, 0.0f, 0.0f, 1.0f, 210.0f, 17.0f) \
  X(tongue, 0.0f, 0.0f, 1.0f, 210.0f, 17.0f) \
  X(pant, 0.0f, 0.0f, 1.0f, 60.0f, 14.0f) \
  X(wobble, 0.0f, 0.0f, 1.0f, 60.0f, 14.0f) \
  X(skew, 0.0f, -1.0f, 1.0f, 210.0f, 17.0f) \
  X(fang, 0.0f, 0.0f, 1.0f, 210.0f, 17.0f) \
  X(blush, 0.0f, 0.0f, 1.0f, 60.0f, 14.0f) \
  X(blushLines, 0.0f, 0.0f, 1.0f, 60.0f, 14.0f) \
  X(vein, 0.0f, 0.0f, 1.0f, 60.0f, 14.0f) \
  X(sweat, 0.0f, 0.0f, 1.0f, 60.0f, 14.0f) \
  X(gloom, 0.0f, 0.0f, 1.0f, 60.0f, 14.0f) \
  X(bubble, 0.0f, 0.0f, 1.0f, 60.0f, 14.0f) \
  X(batt, 0.0f, 0.0f, 1.3f, 260.0f, 14.0f) \
  X(lick, 0.0f, 0.0f, 1.0f, 60.0f, 14.0f) \
  X(earPerk, 0.0f, -1.5f, 1.5f, 150.0f, 6.0f) \
  X(earBack, 0.0f, 0.0f, 1.0f, 150.0f, 6.0f) \
  X(earL, 0.0f, -60.0f, 60.0f, 150.0f, 6.0f) \
  X(earR, 0.0f, -60.0f, 60.0f, 150.0f, 6.0f) \
  X(tilt, 0.0f, -370.0f, 370.0f, 120.0f, 10.0f) \
  X(bob, 0.0f, -24.0f, 24.0f, 120.0f, 10.0f) \
  X(headSX, 1.0f, 0.7f, 1.35f, 260.0f, 14.0f) \
  X(headSY, 1.0f, 0.7f, 1.35f, 260.0f, 14.0f) \
  X(shakeX, 0.0f, -12.0f, 12.0f, 700.0f, 22.0f) \
  X(dim, 0.0f, 0.0f, 0.85f, 40.0f, 12.0f)
